## Kconfig
```kconfig
menu "K-FSW reusable modules"

source "$(ZEPHYR_KFSW_MODULES_MODULE_DIR)/boton-test/Kconfig"
source "$(ZEPHYR_KFSW_MODULES_MODULE_DIR)/radio-uhf/Kconfig"

endmenu
```

## boton-test/Kconfig
```kconfig
menuconfig KFSW_BOTON_TEST
	bool "K-FSW boton_test example module"
	depends on KFSW_PARAM
	help
	  Enable the reusable button example module. The module owns debounced
	  press semantics, volatile runtime status, a typed status API, and its
	  read-only PARAM definitions.

if KFSW_BOTON_TEST

config KFSW_BOTON_TEST_GPIO
	bool "Physical GPIO button input"
	depends on GPIO
	help
	  Bind boton_test to the GPIO node selected by the composition's
	  kfsw,boton-test-button Devicetree chosen property. Leave this disabled
	  for software-only state and PARAM tests.

config KFSW_BOTON_TEST_LED_GPIO
	bool "Physical GPIO LED outputs"
	depends on GPIO
	help
	  Bind the green, blue, and red hardware-test LEDs to GPIO nodes selected
	  by the composition's kfsw,boton-test-led-* Devicetree chosen
	  properties. Each node's GPIO flags define its active polarity.

config KFSW_BOTON_TEST_DEBOUNCE_MS
	int "Button debounce interval in milliseconds"
	depends on KFSW_BOTON_TEST_GPIO
	range 1 1000
	default 30
	help
	  Delay from the most recent GPIO edge until the logical button level is
	  sampled. Each new edge restarts this interval.

config KFSW_BOTON_TEST_SHELL
	bool "boton_test hardware-test shell commands"
	depends on SHELL
	default y
	help
	  Add `boton_test status`, which reports the module's typed status
	  snapshot, and `test led <green|blue|red> <on|off>`, which controls the
	  same module-owned LED state exposed through PARAM.

endif # KFSW_BOTON_TEST
```

## button-test/Kconfig
```kconfig
menuconfig KFSW_BUTTON_TEST
	bool "K-FSW button_test example module"
	depends on KFSW_PARAM
	help
	  Enable the button and LED example module: debounced presses, a status
	  API and read-only parameters.

if KFSW_BUTTON_TEST

config KFSW_BUTTON_TEST_GPIO
	bool "Physical GPIO button input"
	depends on GPIO
	help
	  Bind button_test to the GPIO node selected by the composition's
	  kfsw,button-test-button Devicetree chosen property. Leave this disabled
	  for software-only state and PARAM tests.

config KFSW_BUTTON_TEST_LED_GPIO
	bool "Physical GPIO LED outputs"
	depends on GPIO
	help
	  Bind the green, blue, and red hardware-test LEDs to GPIO nodes selected
	  by the composition's kfsw,button-test-led-* Devicetree chosen
	  properties. Each node's GPIO flags define its active polarity.

config KFSW_BUTTON_TEST_DEBOUNCE_MS
	int "Button debounce interval in milliseconds"
	depends on KFSW_BUTTON_TEST_GPIO
	range 1 1000
	default 30
	help
	  Delay from the most recent GPIO edge until the logical button level is
	  sampled. Each new edge restarts this interval.

config KFSW_BUTTON_TEST_SHELL
	bool "button_test hardware-test shell commands"
	depends on SHELL
	default y
	help
	  Add `button_test status` and `test led <green|blue|red> <on|off>`.

endif # KFSW_BUTTON_TEST
```

## gpredict/Kconfig
```kconfig
menuconfig KFSW_GPREDICT
	bool "K-FSW pass tracking module"
	help
	  Enable pass tracking: the state machine that decides whether a gap in
	  the bearings is a predictor that stalled or a pass that ended. The
	  hamlib conversations with gpredict itself are not part of this module.

if KFSW_GPREDICT

config KFSW_GPREDICT_GRACE_MS
	int "Grace period before silence ends the pass, in milliseconds"
	range 250 600000
	default 5000
	help
	  How long the antenna holds its last bearing before parking. Too short
	  parks in the middle of a pass every time the predictor or the link to
	  it hesitates, and the rest of the pass is lost. Too long leaves the
	  antenna pointing at empty sky after the pass, and the next pass starts
	  with a full slew instead of a short one. Half the shortest useful pass
	  is a safe ceiling.

config KFSW_GPREDICT_PARK_AZIMUTH_DEG
	int "Park azimuth in degrees"
	range 0 360
	default 0
	help
	  Where the antenna waits between passes. A park bearing on the far side
	  of the travel from the usual rise azimuth spends the start of every
	  pass slewing.

config KFSW_GPREDICT_PARK_ELEVATION_DEG
	int "Park elevation in degrees"
	range 0 90
	default 0
	help
	  Low sheds wind, water and ice onto the mast instead of into the dish,
	  and keeps the sun out of the feed. High shortens the slew into the
	  next pass. Nothing between the two is free.

config KFSW_GPREDICT_AZIMUTH_MIN_DEG
	int "Lowest azimuth the rotator may be sent, in degrees"
	range 0 360
	default 0
	help
	  Narrower than the rotator can reach refuses bearings it would have
	  followed, and the refused ones are at the start and end of a pass where
	  the link is already worst. Wider than it can reach drives it into its
	  stops.

config KFSW_GPREDICT_AZIMUTH_MAX_DEG
	int "Highest azimuth the rotator may be sent, in degrees"
	range 0 360
	default 360
	help
	  See the minimum. The two together are the travel this module will
	  command, and a bearing outside them is refused rather than clamped: a
	  clamped bearing points at the wrong sky and says nothing about it.

config KFSW_GPREDICT_ELEVATION_MIN_DEG
	int "Lowest elevation the rotator may be sent, in degrees"
	range 0 90
	default 0
	help
	  Zero is the horizon, which is the floor whatever else is configured.
	  Raising it refuses the first and last minutes of every pass, which is
	  where a low-elevation link is acquired.

config KFSW_GPREDICT_ELEVATION_MAX_DEG
	int "Highest elevation the rotator may be sent, in degrees"
	range 0 90
	default 90
	help
	  Below the rotator's real limit refuses the middle of a high pass, which
	  is the strongest part of it. At or above the limit drives the mast into
	  its stop at the top of the pass.

config KFSW_GPREDICT_PROFILES
	int "Spacecraft profile slots"
	range 1 8
	default 3
	help
	  Every slot is 56 bytes of RAM on the reference targets, reserved at
	  build time whether or not a profile is ever defined in it. Eight slots
	  cost 448 bytes; one slot leaves the node able to follow a single
	  spacecraft and nothing else.

endif # KFSW_GPREDICT
```

## radio-uhf/Kconfig
```kconfig
menuconfig KFSW_RADIO_UHF
	bool "K-FSW reusable UHF radio module"
	help
	  Enable the reusable UHF-radio identity, expected configuration, and
	  bounded diagnostic API. Generic CSP, KISS, and UART data transport remain
	  owned by kfsw-comms.

if KFSW_RADIO_UHF

choice KFSW_RADIO_UHF_IMPLEMENTATION
	prompt "UHF radio implementation"
	default KFSW_RADIO_UHF_HOLYBRO
	help
	  Select exactly one physical UHF radio implementation at build time.

config KFSW_RADIO_UHF_HOLYBRO
	bool "Holybro SiK transparent serial radio"
	help
	  Select the Holybro SiK implementation. This module reports configured
	  expectations but does not enter SiK command mode or alter radio settings.

endchoice

config KFSW_RADIO_UHF_EXPECTED_SERIAL_BAUD
	int "Expected transparent-radio serial baud"
	range 1200 1000000
	default 57600 if KFSW_RADIO_UHF_HOLYBRO
	help
	  Build-time expectation for the serial transport connected to the selected
	  radio. This value is not applied to the UART or read back from hardware;
	  the target devicetree remains authoritative for the actual UART rate.

config KFSW_RADIO_UHF_SHELL
	bool "UHF radio diagnostic shell command"
	depends on SHELL
	default y
	help
	  Add the small `uhf status` diagnostic command. It reports only selected
	  implementation and configured expectations; it does not probe RF state.

config KFSW_RADIO_UHF_CRYPTO
	bool "Authenticated AES-256 radio link"
	depends on KFSW_CSP_KISS_UART && KFSW_PARAM && KFSW_STORAGE
	select KFSW_CSP_UART_CODEC
	select MBEDTLS
	select MBEDTLS_PSA_CRYPTO_C
	select MBEDTLS_PSA_STATIC_KEY_SLOTS
	select PSA_WANT_KEY_TYPE_AES
	select PSA_WANT_ALG_GCM
	select PSA_WANT_KEY_TYPE_HMAC
	select PSA_WANT_ALG_HMAC
	select PSA_WANT_ALG_SHA_256
	help
	  Protect the selected UART link on both flight and ground. Provision a
	  256-bit key locally. Fresh authenticated sessions reject old frames
	  after reset without per-packet flash writes. Missing keys fail closed.

config KFSW_RADIO_UHF_CRYPTO_INTERFACE
	string "KISS interface connected to the radio"
	depends on KFSW_RADIO_UHF_CRYPTO
	default "KISS"

endif # KFSW_RADIO_UHF
```

## temperature-sensor-example/Kconfig
```kconfig
menuconfig KFSW_TEMPERATURE_SENSOR_EXAMPLE
	bool "K-FSW temperature sensor example module"
	depends on KFSW_PARAM
	help
	  Enable the temperature sensor example: a cached reading, read
	  counters and read-only parameters for housekeeping.

if KFSW_TEMPERATURE_SENSOR_EXAMPLE

config KFSW_TEMP_EXAMPLE_SENSOR
	bool "Read a physical temperature sensor"
	depends on SENSOR
	help
	  Poll the sensor selected by the kfsw,die-temp chosen property. Leave
	  this off to build without hardware, as the unit tests do.

config KFSW_TEMP_EXAMPLE_PERIOD_MS
	int "Sensor polling interval in milliseconds"
	depends on KFSW_TEMP_EXAMPLE_SENSOR
	range 100 3600000
	default 1000
	help
	  How often the cached reading is refreshed. Housekeeping reads the
	  cache, so collecting faster than this repeats the same reading.

config KFSW_TEMP_EXAMPLE_MAX_AGE_MS
	int "Maximum cached reading age in milliseconds"
	range 100 7200000
	default 3000
	help
	  Older readings are returned as invalid without accessing the sensor.
	  Set this above the poll interval plus the permitted conversion delay.

config KFSW_TEMP_EXAMPLE_STACK_SIZE
	int "Sensor workqueue stack size"
	depends on KFSW_TEMP_EXAMPLE_SENSOR
	range 1024 8192
	default 1536

config KFSW_TEMP_EXAMPLE_PRIORITY
	int "Sensor workqueue priority"
	depends on KFSW_TEMP_EXAMPLE_SENSOR
	range 2 15
	default 5
	help
	  Use a lower scheduling priority than the CSP router and health work.

config KFSW_TEMP_EXAMPLE_SHELL
	bool "Temperature example shell command"
	depends on SHELL
	default y
	help
	  Add `temp status`, which prints the cached reading and the counters.

endif # KFSW_TEMPERATURE_SENSOR_EXAMPLE
```

## tests/boton_test/testcase.yaml
```yaml
tests:
  kfsw.modules.boton_test:
    tags:
      - kfsw
      - modules
      - button
      - parameter
    platform_allow:
      - native_sim/native/64
    integration_platforms:
      - native_sim/native/64
    extra_configs:
      - CONFIG_KFSW_BOTON_TEST_GPIO=n
  kfsw.modules.boton_test.gpio:
    tags:
      - kfsw
      - modules
      - button
      - gpio
      - parameter
    platform_allow:
      - native_sim/native/64
    integration_platforms:
      - native_sim/native/64
    extra_configs:
      - CONFIG_GPIO=y
      - CONFIG_GPIO_EMUL=y
      - CONFIG_KFSW_BOTON_TEST_GPIO=y
      - CONFIG_KFSW_BOTON_TEST_DEBOUNCE_MS=30
```

## tests/radio_uhf/testcase.yaml
```yaml
tests:
  kfsw.modules.radio_uhf:
    tags:
      - kfsw
      - modules
      - radio
      - uhf
    platform_allow:
      - native_sim/native/64
  kfsw.modules.radio_uhf.shell:
    tags:
      - kfsw
      - modules
      - radio
      - uhf
      - shell
    platform_allow:
      - native_sim/native/64
    extra_configs:
      - CONFIG_SHELL=y
      - CONFIG_KFSW_RADIO_UHF_SHELL=y
```

## tests/temperature_sensor_example/testcase.yaml
```yaml
tests:
  kfsw.modules.temperature_sensor_example:
    tags:
      - kfsw
      - modules
      - sensor
      - parameter
    platform_allow:
      - native_sim/native/64
    integration_platforms:
      - native_sim/native/64
    extra_configs:
      - CONFIG_KFSW_TEMP_EXAMPLE_SENSOR=n
```
